## CMakeLists.txt
```
# SPDX-License-Identifier: MIT

cmake_minimum_required(VERSION 3.13.1)
find_package(Zephyr REQUIRED HINTS $ENV{ZEPHYR_BASE})
project(advertise_bme280)

target_sources(app PRIVATE src/bme280.c src/main.c)
```

## prj.conf
```kconfig
# Enable Bluetooth
CONFIG_BT=y

# Enable BME280 sensor
CONFIG_I2C=y
CONFIG_SENSOR=y
CONFIG_BME280=y
```

## src/main.c
```c
/*
 * Advertise BME280 sensor data in BLE manufacturer-specific data.
 *
 * Copyright (c) 2021 Koen Vervloesem
 *
 * SPDX-License-Identifier: MIT
 */

#include <stddef.h>
#include <stdio.h>
#include <zephyr/bluetooth/bluetooth.h>
#include <zephyr/bluetooth/hci.h>
#include <zephyr/sys/printk.h>
#include <zephyr/sys/util.h>
#include <zephyr/types.h>

#include "bme280.h"

#define ADV_PARAM                                                    \
  BT_LE_ADV_PARAM(0, BT_GAP_ADV_SLOW_INT_MIN,                        \
                  BT_GAP_ADV_SLOW_INT_MAX, NULL)

static struct bt_data ad[] = {
    BT_DATA_BYTES(BT_DATA_FLAGS, BT_LE_AD_NO_BREDR),
    BT_DATA_BYTES(
        BT_DATA_MANUFACTURER_DATA, 0xff, 0xff, /* Test company ID */
        0x00, 0x00, /* Temperature, int16, little-endian */
        0x00, 0x00, /* Pressure - 50000, uint16, little-endian */
        0x00, 0x00) /* Humidity, uint16, little-endian */
};

void update_ad_bme280(const struct device *dev) {
  int16_t temperature;
  uint16_t pressure, humidity;

  bme280_fetch_sample(dev);

  temperature = bme280_get_temperature(dev);
  memcpy(&(ad[1].data[2]), &temperature, 2);

  pressure = bme280_get_pressure(dev);
  memcpy(&(ad[1].data[4]), &pressure, 2);

  humidity = bme280_get_humidity(dev);
  memcpy(&(ad[1].data[6]), &humidity, 2);
}

void main(void) {
  int err;

  printk("Starting firmware...\n");

  // Initialize BME280
  const struct device *bme280 = bme280_get_device();

  if (bme280 == NULL) {
    return;
  }

  // Initialize the Bluetooth subsystem
  err = bt_enable(NULL);
  if (err) {
    printk("Bluetooth init failed (err %d)\n", err);
    return;
  }

  printk("Bluetooth initialized\n");

  // Start advertising sensor values
  update_ad_bme280(bme280);
  err = bt_le_adv_start(ADV_PARAM, ad, ARRAY_SIZE(ad), NULL, 0);

  if (err) {
    printk("Advertising failed to start (err %d)\n", err);
    return;
  }

  while (1) {
    k_sleep(K_MSEC(980));
    // Update advertised sensor values
    update_ad_bme280(bme280);
    err = bt_le_adv_update_data(ad, ARRAY_SIZE(ad), NULL, 0);

    if (err) {
      printk("Advertising update failed (err %d)\n", err);
      return;
    }
  }
}
```

## src/bme280.c
```c
/*
 * Read BME280 sensor data.
 *
 * Copyright (c) 2021 Koen Vervloesem
 *
 * SPDX-License-Identifier: MIT
 */

#include <zephyr/device.h>
#include <zephyr/devicetree.h>
#include <zephyr/drivers/sensor.h>
#include <zephyr/sys/printk.h>
#include <zephyr/types.h>

/*
 * Get a device structure from a devicetree node with compatible
 * "bosch,bme280". (If there are multiple, just pick one.)
 */
const struct device *bme280_get_device(void) {
  const struct device *dev = DEVICE_DT_GET_ANY(bosch_bme280);

  if (dev == NULL) {
    /* No such node, or the node does not have status "okay". */
    printk("\nError: no device found.\n");
    return NULL;
  }

  if (!device_is_ready(dev)) {
    printk("\nError: Device \"%s\" is not ready; "
           "check the driver initialization logs for errors.\n",
           dev->name);
    return NULL;
  }

  printk("Found device \"%s\", getting sensor data\n", dev->name);
  return dev;
}

void bme280_fetch_sample(const struct device *dev) {
  sensor_sample_fetch(dev);
}

int16_t bme280_get_temperature(const struct device *dev) {
  struct sensor_value temperature;

  sensor_channel_get(dev, SENSOR_CHAN_AMBIENT_TEMP, &temperature);
  return (int16_t)(temperature.val1 * 100 + temperature.val2 / 10000);
}

uint16_t bme280_get_pressure(const struct device *dev) {
  struct sensor_value pressure;
  uint32_t p; // Pressure without offset

  sensor_channel_get(dev, SENSOR_CHAN_PRESS, &pressure);
  p = (uint32_t)(pressure.val1 * 1000 + pressure.val2 / 10000);
  return (uint16_t)(p - 50000);
}

uint16_t bme280_get_humidity(const struct device *dev) {
  struct sensor_value humidity;

  sensor_channel_get(dev, SENSOR_CHAN_HUMIDITY, &humidity);
  return (uint16_t)(humidity.val1 * 100 + humidity.val2 / 10000);
}
```

## src/bme280.h
```c
/*
 * Read BME280 sensor data.
 *
 * Copyright (c) 2021 Koen Vervloesem
 *
 * SPDX-License-Identifier: MIT
 */

#ifndef BME280_H_
#define BME280_H_

const struct device *bme280_get_device(void);
void bme280_fetch_sample(const struct device *dev);
int16_t bme280_get_temperature(const struct device *dev);
uint16_t bme280_get_pressure(const struct device *dev);
uint16_t bme280_get_humidity(const struct device *dev);

#endif /* BME280_H_ */
```
